## config/boards/shields/frogboard/Kconfig.defconfig
```kconfig
if SHIELD_FROGBOARD_LEFT
    
    config ZMK_KEYBOARD_NAME
        default "Frogboard"
    
    config ZMK_SPLIT_ROLE_CENTRAL
        default y
    
endif

if SHIELD_FROGBOARD_LEFT || SHIELD_FROGBOARD_RIGHT

    config ZMK_SPLIT
        default y

endif
```

## config/boards/shields/frogboard/Kconfig.shield
```kconfig
config SHIELD_FROGBOARD_LEFT
    def_bool $(shields_list_contains,frogboard_left)
config SHIELD_FROGBOARD_RIGHT
    def_bool $(shields_list_contains,frogboard_right)
```
